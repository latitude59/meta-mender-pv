## meta-mender-freescale/conf/layer.conf
```bitbake
# Board specific layer configuration for meta-mender

# We have a conf and classes directory, add to BBPATH
BBPATH .= ":${LAYERDIR}"

# We have recipes-* directories, add to BBFILES
BBFILES += "${LAYERDIR}/recipes-*/*/*.bb \
	${LAYERDIR}/recipes-*/*/*.bbappend"

BBFILE_COLLECTIONS += "mender-freescale"
BBFILE_PATTERN_mender-freescale = "^${LAYERDIR}/"
BBFILE_PRIORITY_mender-freescale = "10"

IMAGE_BOOTLOADER_FILE_imx7dsabresd = "u-boot.imx"
# Calculated in Mender as IMAGE_BOOTLOADER_BOOTSECTOR_OFFSET * 512 / 1024
# We want the result to be 1 per the standard imx7dsabresd wks file
# so we set this to 2.
IMAGE_BOOTLOADER_BOOTSECTOR_OFFSET_imx7dsabresd = "2"
MENDER_BOOT_PART_SIZE_MB_imx7dsabresd = "0"
```
